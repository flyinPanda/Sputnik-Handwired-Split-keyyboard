## config/west.yml
```yaml
manifest:
  remotes:
    - name: zmkfirmware
      url-base: https://github.com/zmkfirmware
  projects:
    - name: zmk
      remote: zmkfirmware
      revision: 2470f1a562ad8fbde6c0b396e6a1005a76987c0e
      import: app/west.yml
  self:
    path: config
  
```
